#include <layouts/common/ortho_4x12/1x2u.dtsi>
#include <layouts/common/ortho_4x12/all1u.dtsi>

&layout_ortho_4x12_1x2u {
    transform = <&default_transform>;
};
&layout_ortho_4x12_all1u {
    transform = <&default_transform>;
};
